## build/Kconfig/arch/Kconfig
```kconfig
# Load arch Kconfig descriptions.
osource "/home/master/zephyrproject/zephyr/arch/x86/Kconfig"
osource "/home/master/zephyrproject/zephyr/arch/xtensa/Kconfig"
osource "/home/master/zephyrproject/zephyr/arch/sparc/Kconfig"
osource "/home/master/zephyrproject/zephyr/arch/riscv/Kconfig"
osource "/home/master/zephyrproject/zephyr/arch/posix/Kconfig"
osource "/home/master/zephyrproject/zephyr/arch/nios2/Kconfig"
osource "/home/master/zephyrproject/zephyr/arch/mips/Kconfig"
osource "/home/master/zephyrproject/zephyr/arch/arm64/Kconfig"
osource "/home/master/zephyrproject/zephyr/arch/arm/Kconfig"
osource "/home/master/zephyrproject/zephyr/arch/arc/Kconfig"
```
